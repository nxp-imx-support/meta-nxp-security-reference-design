## meta-secure-boot/conf/layer.conf
```bitbake
# We have a conf and classes directory, append to BBPATH
BBPATH .= ":${LAYERDIR}"

# We have a recipes directory, add to BBFILES
BBFILES += "${LAYERDIR}/recipes-*/*/*.bb ${LAYERDIR}/recipes-*/*/*.bbappend"

BBFILE_COLLECTIONS += "imx-secure-boot"
BBFILE_PATTERN_imx-secure-boot := "^${LAYERDIR}/"
BBFILE_PRIORITY_imx-secure-boot = "9"

MACHINE_FEATURES:append = " linux-imx-signature imx-boot-signature u-boot-imx-signature"

LAYERSERIES_COMPAT_imx-secure-boot = " mickledore"
```
